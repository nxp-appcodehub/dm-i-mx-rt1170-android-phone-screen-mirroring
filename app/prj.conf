## CMakeLists.txt
```
#
# Copyright 2024-2026 NXP
#
# SPDX-License-Identifier: Apache-2.0
#

cmake_minimum_required(VERSION 3.20.0)
find_package(Zephyr REQUIRED HINTS $ENV{ZEPHYR_BASE})
project(scrmirror)

set(JPEGDEC_DIR ${CMAKE_CURRENT_SOURCE_DIR}/../JPEGDEC/src)

zephyr_library_include_directories(${JPEGDEC_DIR})

FILE(GLOB app_sources src/*.c ${JPEGDEC_DIR}/jpeg.c)
target_sources(app PRIVATE ${app_sources})

if (CONFIG_NET_STACK_CODE_RELOCATE)
  # Relocate key networking stack components and L2 layer to RAM
  zephyr_code_relocate(LIBRARY subsys__net__ip
    LOCATION "${CONFIG_NET_STACK_CODE_RAM_NAME}_TEXT" NOKEEP)
  zephyr_code_relocate(LIBRARY subsys__net
    LOCATION "${CONFIG_NET_STACK_CODE_RAM_NAME}_TEXT" NOKEEP)
if (CONFIG_NET_L2_ETHERNET)
  zephyr_code_relocate(LIBRARY drivers__ethernet
    LOCATION "${CONFIG_NET_STACK_CODE_RAM_NAME}_TEXT" NOKEEP)
  zephyr_code_relocate(LIBRARY subsys__net__l2__ethernet
    LOCATION "${CONFIG_NET_STACK_CODE_RAM_NAME}_TEXT" NOKEEP)
endif()
endif()
```

## Kconfig
```
# Copyright 2024-2026 NXP
# SPDX-License-Identifier: Apache-2.0

source "Kconfig.zephyr"

config NET_STACK_CODE_RELOCATE
	bool "Relocate networking code into RAM"
	select CODE_DATA_RELOCATION
	help
	  Relocate networking code into RAM when running the zperf
	  sample. Can improve performance on platforms with fast code
	  RAM.

if NET_STACK_CODE_RELOCATE

config NET_STACK_CODE_RAM_NAME
	string "Networking code RAM location"
	default "RAM"
	help
	  Region to relocate networking code to

endif # NET_STACK_CODE_RELOCATE

config RECV_THREAD_PRIO
	int "Receiving thread priority"
	default 3
	help
	  Set the packet receiving thread preemptive priority

config DECODE_THREAD_PRIO
	int "Decode thread priority"
	default 5
	help
	  Set the frame decoding thread preemptive priority

config STATS_MONITOR
	bool "Enable statistics monitor thread (FPS and CPU load)"
	default y
	help
	  Start a dedicated background thread that periodically logs the
	  measured frames-per-second (FPS) rate of the mirroring pipeline and,
	  when CONFIG_CPU_LOAD is enabled, the current CPU load. Useful for
	  benchmarking throughput and system utilization.

if STATS_MONITOR

config STATS_MONITOR_INTERVAL
	int "Statistics reporting interval (seconds)"
	default 1
	help
	  How often, in seconds, the measured FPS and CPU load are logged.

config STATS_MONITOR_THREAD_PRIO
	int "Statistics monitor thread priority"
	default 4
	help
	  Preemptive priority of the statistics monitor thread. Kept above the
	  receive (RECV_THREAD_PRIO) and decode (DECODE_THREAD_PRIO) threads so
	  that, even when the mirroring pipeline saturates the CPU, the monitor
	  still wakes on schedule and reports FPS and CPU load. Its workload is
	  tiny (a counter read, a CPU-load read and one log line per interval),
	  so the brief preemption does not measurably affect throughput.

endif # STATS_MONITOR

config JPEG_SLAB_SIZE
	int "Size of a jpeg frame buffer slab (in KB)"
	default 512
	help
	  Size of a jpeg frame buffer slab in kilobytes

config JPEG_SLAB_COUNT
	int "Number of jpeg frame buffer slabs"
	default 20
	help
	  Number of slabs to allocate for JPEG frame buffering

choice
	prompt "Control Event protocol"
	default CONTROL_EVENT_TCP

config CONTROL_EVENT_UDP
	bool "Control UDP protocol"
	help
		Control events is reporting using UDP protocol

config CONTROL_EVENT_TCP
	bool "Control TCP protocol"
	help
		Touch events is reporting using TCP protocol

endchoice
```

## sample.yaml
```
# Copyright 2024-2026 NXP
# SPDX-License-Identifier: Apache-2.0

sample:
  name: Video screen mirror
tests:
  sample.video.scrmirror:
    build_only: true
    tags:
      - samples
      - shield
      - net
      - socket
      - display
      - video
    depends_on:
      - display
      - video
      - netif
    platform_allow:
      - mimxrt1170_evk/mimxrt1176/cm7
      - mimxrt1064_evk
    integration_platforms:
      - mimxrt1170_evk/mimxrt1176/cm7
      - mimxrt1064_evk
    extra_args:
      - platform:mimxrt1170_evk/mimxrt1176/cm7:SHIELD="rk055hdmipi4ma0"
      - platform:mimxrt1064_evk:SHIELD="rk043fn66hs_ctg"
```

## prj.conf
```kconfig
#
# Copyright 2024-2026 NXP
#
# SPDX-License-Identifier: Apache-2.0
#

# Kernel options
CONFIG_MAIN_STACK_SIZE=4686800
CONFIG_INIT_STACKS=y
CONFIG_DEVICE_CONFIGURATION_DATA=y

# Shell
CONFIG_SHELL=y
CONFIG_NET_SHELL=y
CONFIG_DEVICE_SHELL=y

# Logging
CONFIG_PRINTK=y
CONFIG_LOG=y
CONFIG_NET_LOG=y

# Display
CONFIG_DISPLAY=y

# Generic networking options
CONFIG_NETWORKING=y
CONFIG_NET_STATISTICS=y
CONFIG_NET_MAX_CONTEXTS=5
CONFIG_NET_TC_TX_COUNT=1
CONFIG_NET_SOCKETS=y
CONFIG_NET_SOCKETS_SERVICE_THREAD_PRIO=3

CONFIG_NET_IPV6=n # needed for CONFIG_ETH_NXP_ENET_HW_ACCELERATION
CONFIG_NET_IPV4=y
CONFIG_NET_IF_UNICAST_IPV4_ADDR_COUNT=1
CONFIG_NET_IF_MAX_IPV4_COUNT=2

CONFIG_NET_TCP=y

# DHCPV4 Server & interface
CONFIG_NET_DHCPV4=y
CONFIG_NET_DHCPV4_SERVER=y
# Reduce probe/decline timeout to speed up tests
# CONFIG_NET_DHCPV4_SERVER_ICMP_PROBE_TIMEOUT=10
# CONFIG_NET_DHCPV4_SERVER_ADDR_DECLINE_TIME=1


CONFIG_NET_CONTEXT_NET_PKT_POOL=y
CONFIG_NET_MAX_CONTEXTS=64
# zperf : 5, sample : 10

# Note: HW accleration does not support IPV6
CONFIG_NET_STACK_CODE_RELOCATE=y
CONFIG_NET_STACK_CODE_RAM_NAME="ITCM"
CONFIG_NET_MAX_CONN=64
CONFIG_NET_L2_ETHERNET=y

CONFIG_NET_CONFIG_SETTINGS=y
CONFIG_NET_CONFIG_MY_IPV4_ADDR="192.0.2.1"
CONFIG_NET_CONFIG_MY_IPV4_NETMASK="255.255.255.0"

CONFIG_SHELL_CMDS_RESIZE=n

CONFIG_CACHE_MANAGEMENT=y
CONFIG_SPEED_OPTIMIZATIONS=y

CONFIG_EVENTS=y

CONFIG_CPU_LOAD=y
# Choose one backend (mutually exclusive Kconfig choice):
CONFIG_CPU_LOAD_BACKEND_RUNTIME_STATS=y   # portable, multi-CPU

# Statistics monitor thread: periodically logs FPS and CPU load together.
CONFIG_STATS_MONITOR=y
CONFIG_STATS_MONITOR_INTERVAL=1
# Run the monitor above the recv (3) and decode (5) threads so it still gets
# scheduled and reports even when the mirroring pipeline saturates the CPU.
CONFIG_STATS_MONITOR_THREAD_PRIO=4

# Optimization for network
# Increase number of ENET driver DMA buffers

CONFIG_SYSTEM_WORKQUEUE_STACK_SIZE=4096
CONFIG_NET_TCP_WORKQ_STACK_SIZE=4096
CONFIG_NET_SOCKETS_SERVICE_STACK_SIZE=4096
CONFIG_NET_RX_STACK_SIZE=4096
CONFIG_NET_TX_STACK_SIZE=4096
CONFIG_NET_MGMT_EVENT_STACK_SIZE=4096
CONFIG_NET_TCP_WORKQ_STACK_SIZE=4096

# Config Input
CONFIG_INPUT=y
CONFIG_INPUT_GT911_MAX_TOUCH_POINTS=5
CONFIG_INPUT_QUEUE_MAX_MSGS=128
CONFIG_NET_SOCKET_MAX_SEND_WAIT=10
```

## overlay-ethernet.conf
```kconfig
CONFIG_NET_DEFAULT_IF_ETHERNET=y
CONFIG_NET_PKT_RX_COUNT=28
CONFIG_NET_PKT_TX_COUNT=14
CONFIG_NET_BUF_RX_COUNT=56
CONFIG_NET_BUF_TX_COUNT=28
CONFIG_NET_BUF_DATA_SIZE=1514
CONFIG_ETH_NXP_ENET_HW_ACCELERATION=y
CONFIG_ETH_NXP_ENET_RX_BUFFERS=16
CONFIG_ETH_NXP_ENET_TX_BUFFERS=16
CONFIG_ETH_NXP_ENET_RX_THREAD_STACK_SIZE=4096
```

## overlay-netusb.conf
```kconfig
#
# Copyright 2024-2026 NXP
#
# SPDX-License-Identifier: Apache-2.0
#

# USB Device settings
CONFIG_USB_DEVICE_STACK=y

# Select USB Configurations
CONFIG_USB_DEVICE_NETWORK_ECM=y
CONFIG_USB_DEVICE_INITIALIZE_AT_BOOT=n

# Logging
CONFIG_USB_DRIVER_LOG_LEVEL_INF=y
CONFIG_USB_DEVICE_LOG_LEVEL_INF=y

CONFIG_NET_PKT_RX_COUNT=28
CONFIG_NET_PKT_TX_COUNT=14
CONFIG_NET_BUF_RX_COUNT=56
CONFIG_NET_BUF_TX_COUNT=28
CONFIG_NET_BUF_DATA_SIZE=1514
```

## overlay-wifi.conf
```kconfig
#
# Copyright 2024-2026 NXP
#
# SPDX-License-Identifier: Apache-2.0
#

# Zephyr Wi-Fi configuration for MURATA IW61x

# Config WIFI
CONFIG_WIFI=y
CONFIG_NXP_WIFI_SOFTAP_SUPPORT=y
CONFIG_ETH_NXP_ENET=n
CONFIG_MDIO_NXP_ENET=n
CONFIG_ETH_PHY_DRIVER=n
CONFIG_WIFI_NXP=y
CONFIG_NXP_IW61X=y
CONFIG_NXP_WIFI_SHELL=y
CONFIG_NXP_IW612_MURATA_2EL_M2=y
CONFIG_NET_DHCPV4_SERVER_ADDR_COUNT=32
CONFIG_NET_DHCPV4_SERVER_ICMP_PROBE_TIMEOUT=100
CONFIG_NET_L2_WIFI_SHELL=y
CONFIG_NET_L2_WIFI_MGMT=y

CONFIG_THREAD_CUSTOM_DATA=y
CONFIG_EVENTS=y
CONFIG_SYS_HEAP_AUTO=y
CONFIG_SCHED_MULTIQ=y

#firmware
CONFIG_NXP_MONOLITHIC_WIFI=y

# wifi driver
CONFIG_WIFI_SHELL_MAX_AP_STA=8
CONFIG_WIFI_MGMT_AP_MAX_NUM_STA=8
CONFIG_NXP_WIFI_TX_TASK_STACK_SIZE=4096
CONFIG_NXP_WIFI_DRIVER_TASK_STACK_SIZE=4096
CONFIG_NXP_WIFI_POWERSAVE_TASK_STACK_SIZE=4096
# net threads priority
CONFIG_IDLE_STACK_SIZE=1024

CONFIG_NET_MGMT_EVENT_QUEUE_SIZE=40

CONFIG_NET_CONFIG_AUTO_INIT=n

# CONFIG_WIFI_LOG_LEVEL_DBG=y
# CONFIG_NXP_WIFI_EXTRA_DEBUG=y
# CONFIG_NXP_WIFI_DEBUG_BUILD=y
# CONFIG_NXP_WIFI_OS_DEBUG=y
# CONFIG_NXP_WIFI_NET_DEBUG=y
# CONFIG_NXP_WIFI_WLCMGR_DEBUG=y
# CONFIG_NXP_WIFI_UAP_DEBUG=y
# CONFIG_NXP_WIFI_PKT_DEBUG=y

CONFIG_NXP_WIFI_SOFTAP_IP_ADDRESS="192.0.2.1"
CONFIG_NXP_WIFI_SOFTAP_IP_GATEWAY="192.0.2.1"
CONFIG_NXP_WIFI_SOFTAP_IP_MASK="255.255.255.0"
CONFIG_NXP_WIFI_SOFTAP_IP_BASE="192.0.2.2"

CONFIG_CODE_DATA_RELOCATION_SRAM=y

CONFIG_NET_PKT_RX_COUNT=96
CONFIG_NET_PKT_TX_COUNT=96
CONFIG_NET_BUF_RX_COUNT=128
CONFIG_NET_BUF_TX_COUNT=128
CONFIG_NET_BUF_DATA_SIZE=2560
CONFIG_NET_TC_TX_COUNT=1
CONFIG_NET_TC_RX_COUNT=1
CONFIG_NET_MGMT_EVENT_QUEUE_SIZE=20
CONFIG_NET_IF_MAX_IPV4_COUNT=3
CONFIG_NET_IPV4_FRAGMENT=y
CONFIG_NET_IPV4_FRAGMENT_MAX_COUNT=3
CONFIG_NET_IPV4_FRAGMENT_MAX_PKT=7
CONFIG_NET_IPV4_FRAGMENT_TIMEOUT=3
CONFIG_NET_MAX_CONN=10
CONFIG_NET_L2_ETHERNET=y


CONFIG_SDIO_STACK=y
CONFIG_SD_CMD_RETRIES=3
CONFIG_SD_RETRY_COUNT=0

# CONFIG_NXP_WIFI_IO_DEBUG=y
# CONFIG_SD_LOG_LEVEL_DBG=y
# CONFIG_NXP_WIFI_PKT_DEBUG=y

CONFIG_NET_DEFAULT_IF_WIFI=y
CONFIG_SCHED_MULTIQ=y
CONFIG_NXP_WIFI_TX_RX_ZERO_COPY=y
CONFIG_NXP_WIFI_WMM_UAPSD=n
CONFIG_NXP_WIFI_ROAMING=n
CONFIG_NXP_WIFI_AUTO_POWER_SAVE=n
```

## src/main.c
```c
/*
 * Copyright 2024-2026 NXP
 *
 * SPDX-License-Identifier: Apache-2.0
 */

#include <zephyr/kernel.h>
#include <zephyr/device.h>

#include <zephyr/net/net_if.h>
#include <zephyr/net/net_event.h>
#include <zephyr/net/socket.h>
#include <zephyr/usb/usb_device.h>
#include <zephyr/net/net_config.h>
#include <zephyr/net/wifi_mgmt.h>

#include "screen.h"
#include "decode.h"
#include "stats.h"

#define LOG_LEVEL CONFIG_LOG_DEFAULT_LEVEL
#include <zephyr/logging/log.h>
LOG_MODULE_REGISTER(main);

#define MY_PORT          5000
#define MAX_CLIENT_QUEUE 2

#define WIFI_AP_SSID "screen-mirror-wifi"
#define WIFI_AP_PSK  "nxpdemo2025"
#define MACSTR       "%02X:%02X:%02X:%02X:%02X:%02X"
#define NET_EVENT_WIFI_MASK                                                                        \
	(NET_EVENT_WIFI_CONNECT_RESULT | NET_EVENT_WIFI_DISCONNECT_RESULT |                        \
	 NET_EVENT_WIFI_AP_ENABLE_RESULT | NET_EVENT_WIFI_AP_DISABLE_RESULT |                      \
	 NET_EVENT_WIFI_AP_STA_CONNECTED | NET_EVENT_WIFI_AP_STA_DISCONNECTED)

enum app_state {
	APP_WAIT_FOR_CLIENT,
	APP_RUNNING,
	APP_ERROR,
};

K_EVENT_DEFINE(application_event);

int main(void)
{
	struct sockaddr_in addr, client_addr;
	socklen_t client_addr_len = sizeof(client_addr);
	int ret, sock, video_sock;
	struct net_if *iface;
	enum app_state cur_state, next_state;

	iface = net_if_get_default();

#if defined(CONFIG_USB_DEVICE_NETWORK_ECM)
	ret = usb_enable(NULL);
	if (ret != 0) {
		LOG_ERR("Cannot enable USB (%d)", ret);
		return ret;
	}

	/* Looking for the netusb to configure to override the default iface */
	STRUCT_SECTION_FOREACH(net_if, i_iface) {
		if (strncmp(net_if_get_device(i_iface)->name, "eth_netusb", 10) == 0) {
			iface = i_iface;
			break;
		}
	}
#elif defined(CONFIG_WIFI)
	STRUCT_SECTION_FOREACH(net_if, i_iface) {
		if (strncmp(net_if_get_device(i_iface)->name, "ua", 2) == 0) {
			iface = i_iface;
			break;
		}
	}
	static struct wifi_connect_req_params ap_config;

	if (!iface) {
		LOG_INF("AP: is not initialized");
		return -EIO;
	}

	LOG_INF("Turning on AP Mode");
	ap_config.ssid = (const uint8_t *)WIFI_AP_SSID;
	ap_config.ssid_length = strlen(WIFI_AP_SSID);
	ap_config.psk = (const uint8_t *)WIFI_AP_PSK;
	ap_config.psk_length = strlen(WIFI_AP_PSK);
	ap_config.channel = WIFI_CHANNEL_ANY;
	ap_config.band = WIFI_FREQ_BAND_5_GHZ;
	ap_config.bandwidth = WIFI_FREQ_BANDWIDTH_40MHZ;

	if (strlen(WIFI_AP_PSK) == 0) {
		ap_config.security = WIFI_SECURITY_TYPE_NONE;
	} else {

		ap_config.security = WIFI_SECURITY_TYPE_PSK;
	}

	ret = net_mgmt(NET_REQUEST_WIFI_AP_ENABLE, iface, &ap_config,
		       sizeof(struct wifi_connect_req_params));
#endif

	LOG_INF("Protocol %s is selected", iface->if_dev->dev->name);

	/* Prepare Network */
	(void)memset(&addr, 0, sizeof(addr));
	addr.sin_family = AF_INET;
	addr.sin_port = htons(MY_PORT);

	sock = zsock_socket(AF_INET, SOCK_STREAM, IPPROTO_TCP);
	if (sock < 0) {
		LOG_ERR("Failed to create TCP socket: %d", errno);
		return 0;
	}

	ret = zsock_bind(sock, (struct sockaddr *)&addr, sizeof(addr));
	if (ret < 0) {
		LOG_ERR("Failed to bind TCP socket: %d", errno);
		zsock_close(sock);
		return 0;
	}

	ret = zsock_listen(sock, MAX_CLIENT_QUEUE);
	if (ret < 0) {
		LOG_ERR("Failed to listen on TCP socket: %d", errno);
		zsock_close(sock);
		return 0;
	}

	const struct device *const display_dev = DEVICE_DT_GET(DT_CHOSEN(zephyr_display));

	if (!device_is_ready(display_dev)) {
		LOG_ERR("%s: display device not ready.", display_dev->name);
		return 0;
	}

	int err = display_setup(display_dev);
	if (err) {
		LOG_ERR("Unable to set up display");
		return err;
	}

	control_init();

#if defined(CONFIG_STATS_MONITOR)
	/* Start the background FPS and CPU load monitor thread. */
	stats_monitor_start();
#endif /* CONFIG_STATS_MONITOR */

	cur_state = APP_WAIT_FOR_CLIENT;
	next_state = APP_WAIT_FOR_CLIENT;

	while (1) {
		switch (cur_state) {
		case APP_WAIT_FOR_CLIENT:
			if (net_if_oper_state(iface) != NET_IF_OPER_UP) {
				k_msleep(1000);
				break;
			}

			printk("TCP: Waiting for client...\n");
			video_sock = zsock_accept(sock, (struct sockaddr *)&client_addr,
						  &client_addr_len);
			if (video_sock < 0) {
				printk("Failed to accept: %d\n", errno);
				next_state = APP_ERROR;
			} else {
				printk("TCP: Accepted connection\n");
				client_addr.sin_port = htons(MY_PORT);
				decode_start(&video_sock);

				/* connect_control_socket() may return before the
				 * control connection is established if the video
				 * decode path tore down while it was waiting. In
				 * that case tear everything back down and go back
				 * to waiting for a fresh client instead of moving
				 * to APP_RUNNING with a half-connected session.
				 */
				if (connect_control_socket(sock, &client_addr) != 0) {
					printk("TCP: Control socket not established, "
					       "resetting session\n");
					decode_stop();
					disconnect_control_socket();
					/* Clear any pending events so the next
					 * session starts from a clean slate and
					 * does not tear down immediately on a
					 * stale EVENT_SOCKET_THREAD_STOP bit.
					 */
					k_event_clear(&application_event,
						      EVENT_SOCKET_THREAD_STOP | EVENT_TOUCH_ERROR);
					next_state = APP_WAIT_FOR_CLIENT;

				} else {
					next_state = APP_RUNNING;
				}
			}

			break;
		case APP_RUNNING:
			k_event_wait(&application_event,
				     EVENT_SOCKET_THREAD_STOP | EVENT_TOUCH_ERROR, true, K_FOREVER);
			decode_stop();
			disconnect_control_socket();
			next_state = APP_WAIT_FOR_CLIENT;
			break;
		case APP_ERROR:
			return -EIO;
		}
		cur_state = next_state;
	}

	return 0;
}
```

## src/control_msg.c
```c
#include "control_msg.h"

#include <assert.h>
#include <inttypes.h>
#include <stdlib.h>
#include <string.h>

#include "util/binary.h"
#include "util/log.h"
#include "util/str.h"

/**
 * Map an enum value to a string based on an array, without crashing on an
 * out-of-bounds index.
 */
#define ENUM_TO_LABEL(labels, value) ((size_t)(value) < ARRAY_LEN(labels) ? labels[value] : "???")

#define KEYEVENT_ACTION_LABEL(value) ENUM_TO_LABEL(android_keyevent_action_labels, value)

#define MOTIONEVENT_ACTION_LABEL(value) ENUM_TO_LABEL(android_motionevent_action_labels, value)

#define SCREEN_POWER_MODE_LABEL(value) ENUM_TO_LABEL(screen_power_mode_labels, value)

static const char *const android_keyevent_action_labels[] = {
	"down",
	"up",
	"multi",
};

static const char *const android_motionevent_action_labels[] = {
	"down",         "up",         "move",        "cancel", "outside",
	"pointer-down", "pointer-up", "hover-move",  "scroll", "hover-enter",
	"hover-exit",   "btn-press",  "btn-release",
};

static const char *const screen_power_mode_labels[] = {
	"off", "doze", "normal", "doze-suspend", "suspend",
};

static const char *const copy_key_labels[] = {
	"none",
	"copy",
	"cut",
};

static inline const char *get_well_known_pointer_id_name(uint64_t pointer_id)
{
	switch (pointer_id) {
	case POINTER_ID_MOUSE:
		return "mouse";
	case POINTER_ID_GENERIC_FINGER:
		return "finger";
	case POINTER_ID_VIRTUAL_MOUSE:
		return "vmouse";
	case POINTER_ID_VIRTUAL_FINGER:
		return "vfinger";
	default:
		return NULL;
	}
}

static void write_position(uint8_t *buf, const struct sc_position *position)
{
	sc_write32be(&buf[0], position->point.x);
	sc_write32be(&buf[4], position->point.y);
	sc_write16be(&buf[8], position->screen_size.width);
	sc_write16be(&buf[10], position->screen_size.height);
}

// write length (4 bytes) + string (non null-terminated)
static size_t write_string(const char *utf8, size_t max_len, unsigned char *buf)
{
	size_t len = sc_str_utf8_truncation_index(utf8, max_len);
	sc_write32be(buf, len);
	memcpy(&buf[4], utf8, len);
	return 4 + len;
}

size_t sc_control_msg_serialize(const struct sc_control_msg *msg, unsigned char *buf)
{
	buf[0] = msg->type;
	switch (msg->type) {
	case SC_CONTROL_MSG_TYPE_INJECT_KEYCODE:
		buf[1] = msg->inject_keycode.action;
		sc_write32be(&buf[2], msg->inject_keycode.keycode);
		sc_write32be(&buf[6], msg->inject_keycode.repeat);
		sc_write32be(&buf[10], msg->inject_keycode.metastate);
		return 14;
	case SC_CONTROL_MSG_TYPE_INJECT_TEXT: {
		size_t len = write_string(msg->inject_text.text,
					  SC_CONTROL_MSG_INJECT_TEXT_MAX_LENGTH, &buf[1]);
		return 1 + len;
	}
	case SC_CONTROL_MSG_TYPE_INJECT_TOUCH_EVENT:
		buf[1] = msg->inject_touch_event.action;
		sc_write64be(&buf[2], msg->inject_touch_event.pointer_id);
		write_position(&buf[10], &msg->inject_touch_event.position);
		uint16_t pressure = sc_float_to_u16fp(msg->inject_touch_event.pressure);
		sc_write16be(&buf[22], pressure);
		sc_write32be(&buf[24], msg->inject_touch_event.action_button);
		sc_write32be(&buf[28], msg->inject_touch_event.buttons);
		return 32;
	case SC_CONTROL_MSG_TYPE_INJECT_SCROLL_EVENT:
		write_position(&buf[1], &msg->inject_scroll_event.position);
		int16_t hscroll = sc_float_to_i16fp(msg->inject_scroll_event.hscroll);
		int16_t vscroll = sc_float_to_i16fp(msg->inject_scroll_event.vscroll);
		sc_write16be(&buf[13], (uint16_t)hscroll);
		sc_write16be(&buf[15], (uint16_t)vscroll);
		sc_write32be(&buf[17], msg->inject_scroll_event.buttons);
		return 21;
	case SC_CONTROL_MSG_TYPE_BACK_OR_SCREEN_ON:
		buf[1] = msg->inject_keycode.action;
		return 2;
	case SC_CONTROL_MSG_TYPE_GET_CLIPBOARD:
		buf[1] = msg->get_clipboard.copy_key;
		return 2;
	case SC_CONTROL_MSG_TYPE_SET_CLIPBOARD:
		sc_write64be(&buf[1], msg->set_clipboard.sequence);
		buf[9] = !!msg->set_clipboard.paste;
		size_t len = write_string(msg->set_clipboard.text,
					  SC_CONTROL_MSG_CLIPBOARD_TEXT_MAX_LENGTH, &buf[10]);
		return 10 + len;
	case SC_CONTROL_MSG_TYPE_SET_SCREEN_POWER_MODE:
		buf[1] = msg->set_screen_power_mode.mode;
		return 2;
	case SC_CONTROL_MSG_TYPE_EXPAND_NOTIFICATION_PANEL:
	case SC_CONTROL_MSG_TYPE_EXPAND_SETTINGS_PANEL:
	case SC_CONTROL_MSG_TYPE_COLLAPSE_PANELS:
	case SC_CONTROL_MSG_TYPE_ROTATE_DEVICE:
		// no additional data
		return 1;
	default:
		LOGW("Unknown message type: %u", (unsigned)msg->type);
		return 0;
	}
}

void sc_control_msg_log(const struct sc_control_msg *msg)
{
#define LOG_CMSG(fmt, ...) LOGV("input: " fmt, ##__VA_ARGS__)
	switch (msg->type) {
	case SC_CONTROL_MSG_TYPE_INJECT_KEYCODE:
		LOG_CMSG("key %-4s code=%d repeat=%" PRIu32 " meta=%06lx",
			 KEYEVENT_ACTION_LABEL(msg->inject_keycode.action),
			 (int)msg->inject_keycode.keycode, msg->inject_keycode.repeat,
			 (long)msg->inject_keycode.metastate);
		break;
	case SC_CONTROL_MSG_TYPE_INJECT_TEXT:
		LOG_CMSG("text \"%s\"", msg->inject_text.text);
		break;
	case SC_CONTROL_MSG_TYPE_INJECT_TOUCH_EVENT: {
		int action = msg->inject_touch_event.action & AMOTION_EVENT_ACTION_MASK;
		uint64_t id = msg->inject_touch_event.pointer_id;
		const char *pointer_name = get_well_known_pointer_id_name(id);
		if (pointer_name) {
			// string pointer id
			LOG_CMSG("touch [id=%s] %-4s position=%" PRIi32 ",%" PRIi32
				 " pressure=%f action_button=%06lx buttons=%06lx",
				 pointer_name, MOTIONEVENT_ACTION_LABEL(action),
				 msg->inject_touch_event.position.point.x,
				 msg->inject_touch_event.position.point.y,
				 msg->inject_touch_event.pressure,
				 (long)msg->inject_touch_event.action_button,
				 (long)msg->inject_touch_event.buttons);
		} else {
			// numeric pointer id
			LOG_CMSG("touch [id=%" PRIu64_ "] %-4s position=%" PRIi32 ",%" PRIi32
				 " pressure=%f action_button=%06lx"
				 " buttons=%06lx",
				 id, MOTIONEVENT_ACTION_LABEL(action),
				 msg->inject_touch_event.position.point.x,
				 msg->inject_touch_event.position.point.y,
				 msg->inject_touch_event.pressure,
				 (long)msg->inject_touch_event.action_button,
				 (long)msg->inject_touch_event.buttons);
		}
		break;
	}
	case SC_CONTROL_MSG_TYPE_INJECT_SCROLL_EVENT:
		LOG_CMSG("scroll position=%" PRIi32 ",%" PRIi32 " hscroll=%f"
			 " vscroll=%f buttons=%06lx",
			 msg->inject_scroll_event.position.point.x,
			 msg->inject_scroll_event.position.point.y,
			 msg->inject_scroll_event.hscroll, msg->inject_scroll_event.vscroll,
			 (long)msg->inject_scroll_event.buttons);
		break;
	case SC_CONTROL_MSG_TYPE_BACK_OR_SCREEN_ON:
		LOG_CMSG("back-or-screen-on %s", KEYEVENT_ACTION_LABEL(msg->inject_keycode.action));
		break;
	case SC_CONTROL_MSG_TYPE_GET_CLIPBOARD:
		LOG_CMSG("get clipboard copy_key=%s", copy_key_labels[msg->get_clipboard.copy_key]);
		break;
	case SC_CONTROL_MSG_TYPE_SET_CLIPBOARD:
		LOG_CMSG("clipboard %" PRIu64_ " %s \"%s\"", msg->set_clipboard.sequence,
			 msg->set_clipboard.paste ? "paste" : "nopaste", msg->set_clipboard.text);
		break;
	case SC_CONTROL_MSG_TYPE_SET_SCREEN_POWER_MODE:
		LOG_CMSG("power mode %s", SCREEN_POWER_MODE_LABEL(msg->set_screen_power_mode.mode));
		break;
	case SC_CONTROL_MSG_TYPE_EXPAND_NOTIFICATION_PANEL:
		LOG_CMSG("expand notification panel");
		break;
	case SC_CONTROL_MSG_TYPE_EXPAND_SETTINGS_PANEL:
		LOG_CMSG("expand settings panel");
		break;
	case SC_CONTROL_MSG_TYPE_COLLAPSE_PANELS:
		LOG_CMSG("collapse panels");
		break;
	case SC_CONTROL_MSG_TYPE_ROTATE_DEVICE:
		LOG_CMSG("rotate device");
		break;
	default:
		LOG_CMSG("unknown type: %u", (unsigned)msg->type);
		break;
	}
}

void sc_control_msg_destroy(struct sc_control_msg *msg)
{
	switch (msg->type) {
	case SC_CONTROL_MSG_TYPE_INJECT_TEXT:
		free(msg->inject_text.text);
		break;
	case SC_CONTROL_MSG_TYPE_SET_CLIPBOARD:
		free(msg->set_clipboard.text);
		break;
	default:
		// do nothing
		break;
	}
}
```

## src/control_msg.h
```c
#ifndef SC_CONTROLMSG_H
#define SC_CONTROLMSG_H

#include "common.h"

#include <stdbool.h>
#include <stddef.h>
#include <stdint.h>

#include "android/input.h"
#include "android/keycodes.h"
#include "coords.h"

#define SC_CONTROL_MSG_MAX_SIZE (1 << 18) // 256k

#define SC_CONTROL_MSG_INJECT_TEXT_MAX_LENGTH    300
// type: 1 byte; sequence: 8 bytes; paste flag: 1 byte; length: 4 bytes
#define SC_CONTROL_MSG_CLIPBOARD_TEXT_MAX_LENGTH (SC_CONTROL_MSG_MAX_SIZE - 14)

#define POINTER_ID_MOUSE          UINT64_C(-1)
#define POINTER_ID_GENERIC_FINGER UINT64_C(-2)

// Used for injecting an additional virtual pointer for pinch-to-zoom
#define POINTER_ID_VIRTUAL_MOUSE  UINT64_C(-3)
#define POINTER_ID_VIRTUAL_FINGER UINT64_C(-4)

enum sc_control_msg_type {
	SC_CONTROL_MSG_TYPE_INJECT_KEYCODE,
	SC_CONTROL_MSG_TYPE_INJECT_TEXT,
	SC_CONTROL_MSG_TYPE_INJECT_TOUCH_EVENT,
	SC_CONTROL_MSG_TYPE_INJECT_SCROLL_EVENT,
	SC_CONTROL_MSG_TYPE_BACK_OR_SCREEN_ON,
	SC_CONTROL_MSG_TYPE_EXPAND_NOTIFICATION_PANEL,
	SC_CONTROL_MSG_TYPE_EXPAND_SETTINGS_PANEL,
	SC_CONTROL_MSG_TYPE_COLLAPSE_PANELS,
	SC_CONTROL_MSG_TYPE_GET_CLIPBOARD,
	SC_CONTROL_MSG_TYPE_SET_CLIPBOARD,
	SC_CONTROL_MSG_TYPE_SET_SCREEN_POWER_MODE,
	SC_CONTROL_MSG_TYPE_ROTATE_DEVICE,
};

enum sc_screen_power_mode {
	// see
	// <https://android.googlesource.com/platform/frameworks/base.git/+/pie-release-2/core/java/android/view/SurfaceControl.java#305>
	SC_SCREEN_POWER_MODE_OFF = 0,
	SC_SCREEN_POWER_MODE_NORMAL = 2,
};

enum sc_copy_key {
	SC_COPY_KEY_NONE,
	SC_COPY_KEY_COPY,
	SC_COPY_KEY_CUT,
};

struct sc_control_msg {
	enum sc_control_msg_type type;
	union {
		struct {
			enum android_keyevent_action action;
			enum android_keycode keycode;
			uint32_t repeat;
			enum android_metastate metastate;
		} inject_keycode;
		struct {
			char *text; // owned, to be freed by free()
		} inject_text;
		struct {
			enum android_motionevent_action action;
			enum android_motionevent_buttons action_button;
			enum android_motionevent_buttons buttons;
			uint64_t pointer_id;
			struct sc_position position;
			float pressure;
		} inject_touch_event;
		struct {
			struct sc_position position;
			float hscroll;
			float vscroll;
			enum android_motionevent_buttons buttons;
		} inject_scroll_event;
		struct {
			enum android_keyevent_action action; // action for the BACK key
			// screen may only be turned on on ACTION_DOWN
		} back_or_screen_on;
		struct {
			enum sc_copy_key copy_key;
		} get_clipboard;
		struct {
			uint64_t sequence;
			char *text; // owned, to be freed by free()
			bool paste;
		} set_clipboard;
		struct {
			enum sc_screen_power_mode mode;
		} set_screen_power_mode;
	};
};

// buf size must be at least CONTROL_MSG_MAX_SIZE
// return the number of bytes written
size_t sc_control_msg_serialize(const struct sc_control_msg *msg, unsigned char *buf);

void sc_control_msg_log(const struct sc_control_msg *msg);

void sc_control_msg_destroy(struct sc_control_msg *msg);

#endif
```

## src/coords.h
```c
#ifndef SC_COORDS
#define SC_COORDS

#include <stdint.h>

struct sc_size {
	uint16_t width;
	uint16_t height;
};

struct sc_point {
	int32_t x;
	int32_t y;
};

struct sc_position {
	// The video screen size may be different from the real device screen size,
	// so store to which size the absolute position apply, to scale it
	// accordingly.
	struct sc_size screen_size;
	struct sc_point point;
};

#endif
```

## src/decode.c
```c
/*
 * Copyright 2024-2026 NXP
 *
 * SPDX-License-Identifier: Apache-2.0
 */

#include <string.h>

#include <zephyr/drivers/display.h>
#include <zephyr/kernel.h>
#include <zephyr/logging/log.h>
#include <zephyr/net/socket.h>

#include "decode.h"
#include "JPEGDEC.h"
#include "screen.h"
#include "stats.h"

#define LOG_LEVEL CONFIG_LOG_DEFAULT_LEVEL

LOG_MODULE_REGISTER(decode);

/* Thread management structure */
struct decode_threads {
	struct k_thread parse_decode_thread;
	struct k_thread socket_recv_thread;
	K_KERNEL_STACK_MEMBER(parse_decode_stack, 32768);
	K_KERNEL_STACK_MEMBER(socket_recv_stack, 2048);
};

/* Socket receive context */
struct socket_recv_ctx {
	int control;
	int *socket_fd;
};

/* Decode context */
struct decode_ctx {
	const struct device *display_dev;
};

/* JPEG segment with memory slab pointer */
struct jpeg_frame {
	void *slab_ptr;
	size_t offset;
	size_t size;
	bool is_last_frame;
};

K_MSGQ_DEFINE(jpeg_frames, sizeof(struct jpeg_frame), CONFIG_JPEG_SLAB_COUNT, 4);
K_MEM_SLAB_DEFINE(jpeg_slab, KB(CONFIG_JPEG_SLAB_SIZE), CONFIG_JPEG_SLAB_COUNT, 4);
static struct decode_threads threads;
extern struct k_event application_event;
static struct socket_recv_ctx recv_ctx;
static struct decode_ctx decode_ctx;
static uint8_t scr_buf[CONFIG_MCUX_ELCDIF_FB_SIZE];

/* A JPEG image starts with a SOI marker and ends with an EOI marker */
static const uint8_t jpeg_soi[] = {0xFF, 0xD8};
static const uint8_t jpeg_eoi[] = {0xFF, 0xD9};

static void *find_pattern(const void *haystack, size_t haystacklen, const void *needle,
			  size_t needlelen)
{
	if (!haystack || !needle || haystacklen < needlelen || needlelen == 0) {
		return NULL;
	}

	const uint8_t *h = (const uint8_t *)haystack;
	const uint8_t *n = (const uint8_t *)needle;

	for (size_t i = 0; i <= haystacklen - needlelen; i++) {
		if (memcmp(&h[i], n, needlelen) == 0) {
			return (void *)&h[i];
		}
	}

	return NULL;
}

static int jpeg_decode(uint8_t *jpeg_buffer, size_t size, uint8_t *output_buf,
		       struct display_buffer_descriptor *buf_desc)
{
	int rc;
	JPEGIMAGE jpg;

	rc = JPEG_openRAM(&jpg, jpeg_buffer, size, NULL);
	if (rc == 0) {
		LOG_WRN("JPEG open failed: %d", JPEG_getLastError(&jpg));
		return -1;
	}

	buf_desc->width = JPEG_getWidth(&jpg);
	buf_desc->height = JPEG_getHeight(&jpg);
	buf_desc->pitch = buf_desc->width;
	buf_desc->buf_size = buf_desc->width * buf_desc->height * JPEG_getBpp(&jpg) / 8;

	JPEG_setFramebuffer(&jpg, output_buf);
	JPEG_setPixelType(&jpg, RGB565_LITTLE_ENDIAN);

	rc = JPEG_decode(&jpg, 0, 0, 0);
	if (rc == 0) {
		printk("JPEG decode failed: %d\n", rc);
		return -1;
	}

	return 0;
}

static void socket_recv_task(void *p1, void *p2, void *p3)
{
	struct socket_recv_ctx *ctx = p1;
	struct jpeg_frame end_frame = {NULL, 0};
	uint8_t *current_slab = NULL;
	size_t bytes_in_slab = 0; /* valid bytes held by the slab */
	size_t scan_offset = 0;   /* first byte of the slab not scanned yet */
	size_t frame_offset = 0;  /* offset of the SOI of the frame being received */
	bool in_frame = false;    /* a SOI was seen, its EOI is still missing */
	bool slab_has_frames = false;
	ssize_t recv_len;
	int ret;

	LOG_INF("Socket receiving started");

	/* Allocate first slab */
	ret = k_mem_slab_alloc(&jpeg_slab, (void **)&current_slab, K_FOREVER);
	if (ret != 0) {
		LOG_ERR("Failed to allocate initial slab");
		goto exit;
	}

	while (ctx->control == THREAD_RUN) {
		struct jpeg_frame frame = {.slab_ptr = current_slab};
		size_t scan, keep_from;

		recv_len = zsock_recv(*ctx->socket_fd, current_slab + bytes_in_slab,
				      KB(CONFIG_JPEG_SLAB_SIZE) - bytes_in_slab, 0);
		if (recv_len <= 0) {
			LOG_WRN("Socket receive ended or error: %zd", recv_len);
			break;
		}

		bytes_in_slab += recv_len;

		/* Scanning resumes one byte before the freshly received data so that a
		 * marker split between two zsock_recv() calls is still matched.
		 */
		scan = scan_offset;

		/* Extract every complete image held by the slab. Both markers have to
		 * be matched: the stream may start in the middle of an image, and a
		 * 0xFFD9 byte pair may also show up inside a marker segment payload.
		 * Cutting on EOI alone would hand the decoder data with no SOI, which
		 * is not a valid JPEG image.
		 */
		while (true) {
			uint8_t *marker;

			if (!in_frame) {
				marker = find_pattern(current_slab + scan, bytes_in_slab - scan,
						      jpeg_soi, ARRAY_SIZE(jpeg_soi));
				if (marker == NULL) {
					break;
				}

				frame_offset = (size_t)(marker - current_slab);
				scan = frame_offset + ARRAY_SIZE(jpeg_soi);
				in_frame = true;
			}

			marker = find_pattern(current_slab + scan, bytes_in_slab - scan, jpeg_eoi,
					      ARRAY_SIZE(jpeg_eoi));
			if (marker == NULL) {
				break;
			}

			scan = (size_t)(marker - current_slab) + ARRAY_SIZE(jpeg_eoi);
			in_frame = false;

			frame.offset = frame_offset;
			frame.size = scan - frame_offset;
			frame.is_last_frame = false;
			k_msgq_put(&jpeg_frames, &frame, K_FOREVER);
			slab_has_frames = true;
		}

		/* Keep the image being received. Outside of an image only the last
		 * byte is worth keeping: it may be the 0xFF of a split marker.
		 */
		keep_from = in_frame ? frame_offset : bytes_in_slab - 1;

		if (slab_has_frames) {
			uint8_t *next_slab = NULL;

			/* The slab now belongs to the decode thread: hand it over and
			 * carry the incomplete tail into a fresh one.
			 */
			ret = k_mem_slab_alloc(&jpeg_slab, (void **)&next_slab, K_FOREVER);
			if (ret != 0) {
				LOG_ERR("Failed to allocate slab");
				frame.offset = 0;
				frame.size = 0;
				frame.is_last_frame = true;
				k_msgq_put(&jpeg_frames, &frame, K_FOREVER);
				current_slab = NULL;
				break;
			}

			bytes_in_slab -= keep_from;
			memcpy(next_slab, current_slab + keep_from, bytes_in_slab);

			frame.offset = 0;
			frame.size = 0;
			frame.is_last_frame = true;
			k_msgq_put(&jpeg_frames, &frame, K_FOREVER);

			current_slab = next_slab;
			slab_has_frames = false;
		} else if (keep_from > 0) {
			/* Nothing was queued from this slab, it is still ours: drop the
			 * consumed bytes in place.
			 */
			bytes_in_slab -= keep_from;
			memmove(current_slab, current_slab + keep_from, bytes_in_slab);
		}

		if (in_frame) {
			frame_offset = 0;
		}
		scan_offset = bytes_in_slab - 1;

		/* An image bigger than a whole slab can never be completed. Drop it
		 * and resynchronise on the next SOI, otherwise the next zsock_recv()
		 * would be called with no room left and report the socket as closed.
		 */
		if (bytes_in_slab >= KB(CONFIG_JPEG_SLAB_SIZE)) {
			LOG_WRN("Dropping a JPEG frame larger than %d KB", CONFIG_JPEG_SLAB_SIZE);
			in_frame = false;
			bytes_in_slab = 0;
			scan_offset = 0;
		}
	}

exit:
	/* Cleanup on exit */
	if (current_slab != NULL) {
		k_mem_slab_free(&jpeg_slab, current_slab);
	}

	k_msgq_put(&jpeg_frames, &end_frame, K_FOREVER);
	k_event_post(&application_event, EVENT_SOCKET_THREAD_STOP);
	LOG_INF("Socket receiving thread terminated");
}

static void decode_display_task(void *p1, void *p2, void *p3)
{
	struct decode_ctx *ctx = p1;
	struct jpeg_frame frame;
	struct display_buffer_descriptor buf_desc;

	LOG_INF("Decoding thread started");
	while (k_msgq_get(&jpeg_frames, &frame, K_FOREVER) == 0) {
		if (frame.slab_ptr == NULL) {
			break;
		}

		/* Decode from the correct offset in the slab */
		if (frame.size > 0) {
			uint8_t *jpeg_data = (uint8_t *)frame.slab_ptr + frame.offset;
			if (jpeg_decode(jpeg_data, frame.size, scr_buf, &buf_desc) == 0) {
				display_write(ctx->display_dev, 0, 0, &buf_desc, scr_buf);
#ifdef SCRMIRROR_STATS
				stats_frame_done();
#endif
			}
			LOG_DBG("decoded frame at offset %zu, size %zu bytes", frame.offset,
				frame.size);
		}

		/* Free the memory slab after decoding */
		if (frame.is_last_frame) {
			k_mem_slab_free(&jpeg_slab, frame.slab_ptr);
			LOG_DBG("Freed slab");
		}
	}

	LOG_INF("Decoding thread terminated");
}

void decode_start(int *socket)
{

	k_tid_t tid;

	/* Initialize contexts */
	recv_ctx.control = THREAD_RUN;
	recv_ctx.socket_fd = socket;
	decode_ctx.display_dev = DEVICE_DT_GET(DT_CHOSEN(zephyr_display));

	if (!device_is_ready(decode_ctx.display_dev)) {
		LOG_ERR("Display device not ready");
		return;
	}

	/* Create socket recv thread */
	tid = k_thread_create(&threads.socket_recv_thread, threads.socket_recv_stack,
			      K_THREAD_STACK_SIZEOF(threads.socket_recv_stack), socket_recv_task,
			      &recv_ctx, NULL, NULL, K_PRIO_PREEMPT(CONFIG_RECV_THREAD_PRIO), 0,
			      K_NO_WAIT);
	k_thread_name_set(tid, "socket_recv_task");

	/* Create decode and display thread */
	tid = k_thread_create(&threads.parse_decode_thread, threads.parse_decode_stack,
			      K_THREAD_STACK_SIZEOF(threads.parse_decode_stack),
			      decode_display_task, &decode_ctx, NULL, NULL,
			      K_PRIO_PREEMPT(CONFIG_DECODE_THREAD_PRIO), 0, K_NO_WAIT);
	k_thread_name_set(tid, "parse_decode_display_task");
}

void decode_stop()
{
	struct jpeg_frame frame;

	recv_ctx.control = THREAD_STOP;
	zsock_shutdown(*recv_ctx.socket_fd, ZSOCK_SHUT_RDWR);
	k_thread_join(&threads.socket_recv_thread, K_FOREVER);
	k_thread_join(&threads.parse_decode_thread, K_FOREVER);

	zsock_close(*recv_ctx.socket_fd);

	/* Purge message queue and free any remaining slabs */
	while (k_msgq_get(&jpeg_frames, &frame, K_NO_WAIT) == 0) {
		if (frame.slab_ptr != NULL) {
			k_mem_slab_free(&jpeg_slab, frame.slab_ptr);
		}
	}

	k_msgq_purge(&jpeg_frames);
}
```

## src/decode.h
```c
/*
 * Copyright 2024-2026 NXP
 *
 * SPDX-License-Identifier: Apache-2.0
 */

#ifndef SCRMIRROR_DECODE
#define SCRMIRROR_DECODE

#include <zephyr/kernel.h>

#define SOCKET_RECV_SIZE KB(256)

enum thread_status {
	THREAD_RUN,
	THREAD_STOP,
};

void decode_start(int *socket);
void decode_stop();
#endif
```

## src/display.c
```c
#include <zephyr/kernel.h>
#include <zephyr/drivers/display.h>

#include "screen.h"

#define LOG_LEVEL CONFIG_LOG_DEFAULT_LEVEL
#include <zephyr/logging/log.h>
LOG_MODULE_REGISTER(display);

int display_setup(const struct device *const display_dev)
{
	int ret;

	if (!device_is_ready(display_dev)) {
		LOG_ERR("Device %s not found\n", display_dev->name);
		return -ENODEV;
	}

	LOG_INF("Display device: %s\n", display_dev->name);

	ret = display_set_pixel_format(display_dev, SCR_FORMAT);
	if (ret < 0) {
		LOG_ERR("Unable to set pixel format");
		return ret;
	}

	return display_blanking_off(display_dev);
}
```

## src/screen.h
```c
/*
 * Copyright 2024-2026 NXP
 *
 * SPDX-License-Identifier: Apache-2.0
 */

#ifndef SCRMIRROR_SCREEN
#define SCRMIRROR_SCREEN

#include <zephyr/net/socket.h>

#include "control_msg.h"

#define SCR_WIDTH  DT_PROP(DT_CHOSEN(zephyr_display), width)
#define SCR_HEIGHT DT_PROP(DT_CHOSEN(zephyr_display), height)
#define SCR_BUF_SZ (SCR_WIDTH * SCR_HEIGHT * 2)
#define SCR_FORMAT PIXEL_FORMAT_RGB_565

#define EVENT_SOCKET_THREAD_STOP (1 << 1)
#define EVENT_TOUCH_ERROR        (1 << 2)
#define SENSITIVITY_RADIUS       1

#define MAX_TOUCH_POINTS CONFIG_INPUT_GT911_MAX_TOUCH_POINTS

void control_init(void);
int connect_control_socket(int socket_fd, struct sockaddr_in *client_addr);

int disconnect_control_socket(void);
bool control_socket_is_connected(void);

int display_setup(const struct device *const display_dev);

#endif
```

## src/stats.c
```c
/*
 * Copyright 2024-2026 NXP
 *
 * SPDX-License-Identifier: Apache-2.0
 */

#include <zephyr/kernel.h>
#include <zephyr/logging/log.h>

#if defined(CONFIG_CPU_LOAD)
#include <zephyr/sys/cpu_load.h>
#endif

#include "stats.h"

#define LOG_LEVEL CONFIG_LOG_DEFAULT_LEVEL
LOG_MODULE_REGISTER(stats);

#if defined(CONFIG_STATS_MONITOR)

/* Running count of frames displayed since the last report window. */
static atomic_t frame_count;

/* Monitor thread resources. */
#define STATS_STACK_SIZE 1024
static K_THREAD_STACK_DEFINE(stats_stack, STATS_STACK_SIZE);
static struct k_thread stats_thread;
static bool stats_started;

void stats_frame_done(void)
{
	atomic_inc(&frame_count);
}

static void stats_monitor_task(void *p1, void *p2, void *p3)
{
	ARG_UNUSED(p1);
	ARG_UNUSED(p2);
	ARG_UNUSED(p3);

	const int64_t interval_ms = (int64_t)CONFIG_STATS_MONITOR_INTERVAL * MSEC_PER_SEC;
	int64_t window_start = k_uptime_get();

	LOG_INF("Statistics monitor thread started");

	while (1) {
		k_msleep((int32_t)interval_ms);

		int64_t now = k_uptime_get();
		int64_t elapsed = now - window_start;

		if (elapsed <= 0) {
			elapsed = interval_ms;
		}

		/* Atomically read and reset the frame counter for this window. */
		uint32_t frames = (uint32_t)atomic_set(&frame_count, 0);

		/* FPS scaled by 10 to keep one decimal place without floating point. */
		uint32_t fps_x10 = (uint32_t)((frames * 10000LL) / elapsed);

#if defined(CONFIG_CPU_LOAD)
		/* cpu_load_get() returns per mille (0..1000); reset the window. */
		int load = cpu_load_get(true);

		if (load >= 0) {
			LOG_INF("FPS: %u.%u | CPU: %d.%d%% (%u frames in %lld ms)", fps_x10 / 10U,
				fps_x10 % 10U, load / 10, load % 10, frames, elapsed);
		} else {
			LOG_INF("FPS: %u.%u | CPU: n/a (%u frames in %lld ms)", fps_x10 / 10U,
				fps_x10 % 10U, frames, elapsed);
		}
#else
		LOG_INF("FPS: %u.%u (%u frames in %lld ms)", fps_x10 / 10U, fps_x10 % 10U, frames,
			elapsed);
#endif /* CONFIG_CPU_LOAD */

		window_start = now;
	}
}

void stats_monitor_start(void)
{
	if (stats_started) {
		return;
	}

	k_tid_t tid = k_thread_create(
		&stats_thread, stats_stack, K_THREAD_STACK_SIZEOF(stats_stack), stats_monitor_task,
		NULL, NULL, NULL, K_PRIO_PREEMPT(CONFIG_STATS_MONITOR_THREAD_PRIO), 0, K_NO_WAIT);
	k_thread_name_set(tid, "stats_monitor");
	stats_started = true;
}

#endif
```

## src/stats.h
```c
/*
 * Copyright 2024-2026 NXP
 *
 * SPDX-License-Identifier: Apache-2.0
 */

#ifndef SCRMIRROR_STATS
#define SCRMIRROR_STATS

#include <zephyr/kernel.h>

/*
 * Count one successfully decoded and displayed frame. Safe to call from the
 * decode thread; the value is consumed by the statistics monitor thread.
 */
void stats_frame_done(void);

/*
 * Start the background statistics monitor thread. The thread periodically logs
 * the measured frames-per-second (FPS) and, when CONFIG_CPU_LOAD is enabled,
 * the current CPU load. Safe to call once at startup; subsequent calls are
 * no-ops.
 */
void stats_monitor_start(void);

#endif /* SCRMIRROR_STATS */
```

## src/touch.c
```c
/*
 * Copyright 2024-2026 NXP
 *
 * SPDX-License-Identifier: Apache-2.0
 */

#include <zephyr/kernel.h>
#include <zephyr/kernel/thread.h>
#include <zephyr/input/input.h>
#include <zephyr/net/socket.h>
#include "screen.h"

#define LOG_LEVEL CONFIG_LOG_DEFAULT_LEVEL
#include <zephyr/logging/log.h>
LOG_MODULE_REGISTER(touch_report);

K_MSGQ_DEFINE(sc_control_queue, sizeof(struct sc_control_msg), CONFIG_INPUT_QUEUE_MAX_MSGS, 4);

static void check_alive(struct k_timer *dummy);
static K_TIMER_DEFINE(check_alive_timer, check_alive, NULL);
extern struct k_event application_event;

struct point_event {
	uint16_t x;
	uint16_t y;
	uint16_t state;
};

struct control_data {
	int control_socket;
	struct sockaddr_in *remote_addr;
	uint8_t actual_point_id;
	struct point_event prev_event[MAX_TOUCH_POINTS];
	struct point_event actual_event[MAX_TOUCH_POINTS];
	struct k_work send_work;
	bool is_connected;
};

static struct control_data data;

static uint8_t msg_buf[SC_CONTROL_MSG_MAX_SIZE];

static bool has_touch_moved(const struct point_event *prev_point,
			    const struct point_event *actual_point)
{
	return actual_point->state == 1 && prev_point->state == 1 &&
	       (actual_point->x - prev_point->x) * (actual_point->x - prev_point->x) +
			       (actual_point->y - prev_point->y) *
				       (actual_point->y - prev_point->y) >=
		       SENSITIVITY_RADIUS * SENSITIVITY_RADIUS;
}

static void convert_to_android_event(struct sc_control_msg *android_point,
				     const struct point_event *actual_event,
				     const struct point_event *prev_event)
{
	android_point->type = SC_CONTROL_MSG_TYPE_INJECT_TOUCH_EVENT;
	android_point->inject_touch_event.position.point.x = actual_event->x;
	android_point->inject_touch_event.position.point.y = actual_event->y;
	android_point->inject_touch_event.position.screen_size.height = SCR_HEIGHT;
	android_point->inject_touch_event.position.screen_size.width = SCR_WIDTH;

	if (actual_event->state == 1 && prev_event->state == 0) {
		android_point->inject_touch_event.action = AMOTION_EVENT_ACTION_DOWN;
		android_point->inject_touch_event.pressure = 1.0;
	} else if (actual_event->state == 1 && prev_event->state == 1) {
		android_point->inject_touch_event.action = AMOTION_EVENT_ACTION_MOVE;
		android_point->inject_touch_event.pressure = 1.0;
	} else if (actual_event->state == 0 && prev_event->state == 1) {
		android_point->inject_touch_event.action = AMOTION_EVENT_ACTION_UP;
		android_point->inject_touch_event.pressure = 0.0;
	}

	android_point->inject_touch_event.buttons = 0;
	android_point->inject_touch_event.action_button = 0;
}

static void check_alive(struct k_timer *timer)
{
	struct control_data *p_data = k_timer_user_data_get(timer);
	struct sc_control_msg dummy_msg = {0};

	dummy_msg.type = SC_CONTROL_MSG_TYPE_DUMMY;
	LOG_DBG("Check alive");
	if (p_data->is_connected && k_msgq_num_used_get(&sc_control_queue) == 0) {
		k_msgq_put(&sc_control_queue, &dummy_msg, K_NO_WAIT);
		k_work_submit(&p_data->send_work);
	}
}

static void parse_touch_event_cb(struct input_event *evt, void *user_data)
{
	struct control_data *p_data = user_data;
	struct sc_control_msg actual_msg;

	switch (evt->code) {
	case INPUT_ABS_MT_SLOT:
		p_data->actual_point_id = evt->value < MAX_TOUCH_POINTS ? evt->value : 0;
		if (evt->value >= MAX_TOUCH_POINTS) {
			LOG_WRN("evt_value is greater than MAX_TOUCH_POINTS");
		}
		break;
	case INPUT_ABS_X:
		p_data->actual_event[p_data->actual_point_id].x = evt->value;
		break;
	case INPUT_ABS_Y:
		p_data->actual_event[p_data->actual_point_id].y = evt->value;
		break;
	case INPUT_BTN_TOUCH:
		p_data->actual_event[p_data->actual_point_id].state = evt->value;
		if (p_data->is_connected &&
		    (has_touch_moved(&p_data->prev_event[p_data->actual_point_id],
				     &p_data->actual_event[p_data->actual_point_id]) ||
		     p_data->prev_event[p_data->actual_point_id].state !=
			     p_data->actual_event[p_data->actual_point_id].state)) {
			actual_msg.inject_touch_event.pointer_id = p_data->actual_point_id;
			convert_to_android_event(&actual_msg,
						 &p_data->actual_event[p_data->actual_point_id],
						 &p_data->prev_event[p_data->actual_point_id]);

			k_msgq_put(&sc_control_queue, &actual_msg, K_NO_WAIT);
			k_work_submit(&p_data->send_work);
		}
		p_data->prev_event[p_data->actual_point_id] =
			p_data->actual_event[p_data->actual_point_id];
		break;
	}
}

static void send_work_handler(struct k_work *kwork)
{
	struct sc_control_msg android_evt_data;
	struct control_data *evt_send = CONTAINER_OF(kwork, struct control_data, send_work);

	while (k_msgq_get(&sc_control_queue, &android_evt_data, K_NO_WAIT) == 0) {
		ssize_t msg_len = sc_control_msg_serialize(&android_evt_data, msg_buf);
		ssize_t send_size = zsock_sendto(evt_send->control_socket, msg_buf, msg_len, 0,
						 (const struct sockaddr *)evt_send->remote_addr,
						 sizeof(struct sockaddr));
		if (send_size <= 0) {
			LOG_ERR("Touch socket error");
			k_event_post(&application_event, EVENT_TOUCH_ERROR);
		}
		LOG_DBG("Report touch point %d x: %d y: %d btn: %d ", data.actual_point_id,
			android_evt_data.inject_touch_event.position.point.x,
			android_evt_data.inject_touch_event.position.point.x,
			android_evt_data.inject_touch_event.action);
	}
}

int connect_control_socket(int socket_fd, struct sockaddr_in *client_addr)
{
	int client_addr_len = 0;

	LOG_INF("Wait for control socket ...");

	if (IS_ENABLED(CONFIG_CONTROL_EVENT_TCP)) {
		/* Open another TCP socket for the control event. The accept must not
		 * block forever: if the video stream drops before the client opens
		 * this second connection, the decode thread stops and posts
		 * EVENT_SOCKET_THREAD_STOP. A blocking zsock_accept() here would keep
		 * the state machine parked before APP_RUNNING, so it would never wake
		 * on that event and the board would hang with the decode thread gone
		 * but the touch path still waiting. Poll with a timeout and abort as
		 * soon as the decode thread has signalled that it stopped.
		 */
		struct zsock_pollfd fds = {
			.fd = socket_fd,
			.events = ZSOCK_POLLIN,
		};

		data.control_socket = -1;

		while (true) {
			int ret = zsock_poll(&fds, 1, 100);

			/* The decode/receive path already tore down: give up waiting
			 * for the control connection so the caller can clean up and
			 * return to APP_WAIT_FOR_CLIENT.
			 */
			if (k_event_test(&application_event, EVENT_SOCKET_THREAD_STOP)) {
				LOG_WRN("Decode thread stopped before control socket connected");
				return -ECONNABORTED;
			}

			if (ret < 0) {
				LOG_ERR("Control socket poll error: %d", errno);
				return -EIO;
			}

			if (ret == 0) {
				/* Timeout: re-check the stop condition and keep waiting. */
				continue;
			}

			if (fds.revents & ZSOCK_POLLIN) {
				data.control_socket =
					zsock_accept(socket_fd, (struct sockaddr *)client_addr,
						     &client_addr_len);
				break;
			}
		}
	} else {
		data.control_socket = zsock_socket(AF_INET, SOCK_DGRAM, IPPROTO_UDP);
	}

	if (data.control_socket < 0) {
		LOG_ERR("Failed to accept control socket: %d", errno);
		return -EIO;
	}

	data.remote_addr = client_addr;

	data.is_connected = true;

	LOG_INF("%s control socket is connected",
		IS_ENABLED(CONFIG_CONTROL_EVENT_TCP) ? "TCP" : "UDP");

	k_timer_start(&check_alive_timer, K_MSEC(20000), K_MSEC(20000));

	return 0;
}

int disconnect_control_socket(void)
{
	int ret = 0;

	if (data.is_connected) {
		if (IS_ENABLED(CONFIG_CONTROL_EVENT_TCP)) {
			zsock_shutdown(data.control_socket, SHUT_RDWR);
		}

		ret = zsock_close(data.control_socket);
		if (ret < 0) {
			LOG_ERR("Cannot close the connection %d", errno);
			ret = -EIO;
		}

		data.is_connected = false;
		k_timer_stop(&check_alive_timer);

		LOG_INF("Control socket disconnected");
	}

	return ret;
}

bool control_socket_is_connected(void)
{
	return data.is_connected;
}

void control_init(void)
{
	k_work_init(&data.send_work, send_work_handler);
	k_timer_user_data_set(&check_alive_timer, &data);
}

INPUT_CALLBACK_DEFINE(DEVICE_DT_GET(DT_NODELABEL(gt911_rk055hdmipi4ma0)), parse_touch_event_cb,
		      &data);
```

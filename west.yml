## west.yml
```yaml
# Copyright (c) 2021 Nordic Semiconductor ASA
# SPDX-License-Identifier: Apache-2.0

manifest:
  self:
    path: scrmirror
  defaults:
    remote: zephyrproject-rtos

  remotes:
    - name: zephyrproject-rtos
      url-base: https://github.com/zephyrproject-rtos
    - name: nxp-appcodehub
      url-base: https://github.com/nxp-appcodehub
    - name: nxp-upstream
      url-base: https://github.com/nxp-upstream

  projects:
    - name: zephyr
      remote: nxp-upstream
      revision: screen_mirror_support
      west-commands: scripts/west-commands.yml
      import:
        name-allowlist:
          - cmsis      # required by the ARM port
          - cmsis_6
          - hostap
    - name: hal_nxp
      revision: e4ab95e7409f2c4e5c7a4f482aa66360433d9f60
      path: modules/hal/nxp
      groups:
        - hal
```
